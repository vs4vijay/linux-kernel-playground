## buildroot-configs/arm64/arm64_dev_defconfig
```kconfig
# Generic ARM64 Development Board Buildroot Configuration
# Suitable for various ARM64 development boards and QEMU

# Architecture
BR2_aarch64=y
BR2_ARM_FPU_VFPV4=y
BR2_TOOLCHAIN_BUILDROOT_GLIBC=y
BR2_TOOLCHAIN_BUILDROOT_CXX=y
BR2_KERNEL_HEADERS_6_6=y
BR2_PACKAGE_HOST_LINUX_HEADERS_CUSTOM_6_6=y

# System configuration
BR2_ROOTFS_DEVICE_CREATION_DYNAMIC_DEVTMPFS=y
BR2_ROOTFS_DEVICE_TABLE="system/device_table.txt"
BR2_ROOTFS_SKELETON_CUSTOM=y
BR2_ROOTFS_POST_BUILD_SCRIPT="board/post_build.sh"
BR2_ROOTFS_POST_IMAGE_SCRIPT="support/scripts/genimage.sh"

# Kernel
BR2_LINUX_KERNEL=y
BR2_LINUX_KERNEL_CUSTOM_VERSION=y
BR2_LINUX_KERNEL_CUSTOM_VERSION_VALUE="6.6.21"
BR2_LINUX_KERNEL_USE_CUSTOM_CONFIG=y
BR2_LINUX_KERNEL_CUSTOM_CONFIG_FILE="board/arm64_dev/linux.config"
BR2_LINUX_KERNEL_DTS_SUPPORT=y
BR2_LINUX_KERNEL_INTREE_DTS_NAME="arm64/virt"
BR2_LINUX_KERNEL_INSTALL_TARGET=y
BR2_LINUX_KERNEL_NEEDS_HOST_OPENSSL=y

# Bootloader (U-Boot)
BR2_TARGET_UBOOT=y
BR2_TARGET_UBOOT_BUILD_SYSTEM_KCONFIG=y
BR2_TARGET_UBOOT_CUSTOM_VERSION=y
BR2_TARGET_UBOOT_CUSTOM_VERSION_VALUE="2024.04"
BR2_TARGET_UBOOT_BOARD_DEFCONFIG="qemu_arm64"
BR2_TARGET_UBOOT_NEEDS_DTC=y
BR2_TARGET_UBOOT_NEEDS_PYTHON3=y
BR2_TARGET_UBOOT_NEEDS_SWIG=y
BR2_TARGET_UBOOT_NEEDS_LIBELF=y
BR2_TARGET_UBOOT_FORMAT_IMG=y
BR2_TARGET_UBOOT_BOOT_SCRIPT=y
BR2_TARGET_UBOOT_BOOT_SCRIPT_SOURCE="board/arm64_dev/boot.txt"

# Filesystem
BR2_TARGET_ROOTFS_EXT2=y
BR2_TARGET_ROOTFS_EXT2_4=y
BR2_TARGET_ROOTFS_EXT2_SIZE="512M"
BR2_TARGET_ROOTFS_EXT2_INODES=0
BR2_TARGET_ROOTFS_EXT2_RES_BLOCKS=0
BR2_TARGET_ROOTFS_TAR=y
BR2_TARGET_ROOTFS_TAR_NONE=y

# ARM64 specific packages
BR2_PACKAGE_LIBFUSE=y
BR2_PACKAGE_LIBFUSE3=y

# GPU/Video Support (basic)
BR2_PACKAGE_LIBDRM=y
BR2_PACKAGE_LIBGBM=y

# Audio
BR2_PACKAGE_ALSA_LIB=y
BR2_PACKAGE_ALSA_UTILS=y
BR2_PACKAGE_ALSA_UTILS_ALSACTL=y
BR2_PACKAGE_ALSA_UTILS_APLAY=y
BR2_PACKAGE_ALSA_UTILS_SPEAKER_TEST=y
BR2_PACKAGE_LIBVORBIS=y

# Network
BR2_PACKAGE_NETTOOLS=y
BR2_PACKAGE_IFUPDOWN=y
BR2_PACKAGE_IW=y
BR2_PACKAGE_WIRELESS_TOOLS=y
BR2_PACKAGE_DHCPCD=y
BR2_PACKAGE_DROPBEAR=y
BR2_PACKAGE_DROPBEAR_CLIENT=y
BR2_PACKAGE_BRIDGE=y
BR2_PACKAGE_IPERF3=y

# System utilities
BR2_PACKAGE_HTOP=y
BR2_PACKAGE_NANO=y
BR2_PACKAGE_VIM=y
BR2_PACKAGE_TREE=y
BR2_PACKAGE_FILE=y
BR2_PACKAGE_WHICH=y
BR2_PACKAGE_SCREEN=y
BR2_PACKAGE_TMUX=y

# SSH
BR2_PACKAGE_OPENSSH=y
BR2_PACKAGE_OPENSSH_SERVER=y
BR2_PACKAGE_OPENSSH_CLIENT=y

# Development tools
BR2_PACKAGE_GIT=y
BR2_PACKAGE_CURL=y
BR2_PACKAGE_WGET=y
BR2_PACKAGE_UNZIP=y
BR2_PACKAGE_TAR=y
BR2_PACKAGE_RSYNC=y

# GPIO/I2C/SPI support
BR2_PACKAGE_LIBGPIOD=y
BR2_PACKAGE_LIBGPIOD_TOOLS=y
BR2_PACKAGE_I2C_TOOLS=y
BR2_PACKAGE_SPI_TOOLS=y

# Python
BR2_PACKAGE_PYTHON3=y
BR2_PACKAGE_PYTHON3_PIP=y
BR2_PACKAGE_PYTHON3_SETUPTOOLS=y
BR2_PACKAGE_PYTHON3_NUMPY=y
BR2_PACKAGE_PYTHON3_SERIAL=y

# System Management
BR2_PACKAGE_SYSTEMD=y
BR2_PACKAGE_SYSTEMD_JOURNAL_REMOTE=y
BR2_PACKAGE_SYSTEMD_NETWORKD=y
BR2_PACKAGE_SYSTEMD_RESOLVED=y

# Filesystem support
BR2_PACKAGE_DOSFSTOOLS=y
BR2_PACKAGE_E2FSPROGS=y
BR2_PACKAGE_NTFS_3G=y
BR2_PACKAGE_EXFATPROGS=y
BR2_PACKAGE_SQUASHFS=y
BR2_PACKAGE_NFS_UTILS=y
BR2_PACKAGE_CIFS_UTILS=y

# Compression
BR2_PACKAGE_ZIP=y
BR2_PACKAGE_XZ=y
BR2_PACKAGE_GZIP=y
BR2_PACKAGE_BZIP2=y
BR2_PACKAGE_P7ZIP=y

# Libraries
BR2_PACKAGE_OPENSSL=y
BR2_PACKAGE_OPENSSL_BIN=y
BR2_PACKAGE_ZLIB=y
BR2_PACKAGE_LIBPCAP=y
BR2_PACKAGE_LIBUSB=y
BR2_PACKAGE_LIBUSB_COMPAT=y
BR2_PACKAGE_LIBUSB1=y

# Sensors
BR2_PACKAGE_LM_SENSORS=y

# Real-time Support
BR2_PACKAGE_XENOMAI=y
BR2_PACKAGE_XENOMAI_MERCURY=y

# Security
BR2_PACKAGE_SELINUX=y
BR2_PACKAGE_FAIL2BAN=y
BR2_PACKAGE_AUDIT=y

# Compiler tools
BR2_PACKAGE_GCC=y
BR2_PACKAGE_MAKE=y
BR2_PACKAGE_CMAKE=y
BR2_PACKAGE_AUTOCONF=y
BR2_PACKAGE_AUTOMAKE=y
BR2_PACKAGE_LIBTOOL=y
BR2_PACKAGE_NINJA=y

# Documentation
BR2_PACKAGE_MAN=y
BR2_PACKAGE_MAN_PAGES=y
BR2_PACKAGE_INFO=y

# Monitoring
BR2_PACKAGE_VMSTAT=y
BR2_PACKAGE_IOSTAT=y
BR2_PACKAGE_MPSTAT=y
BR2_PACKAGE_PIDSTAT=y
BR2_PACKAGE_NMON=y

# Performance analysis
BR2_PACKAGE_PERF=y

# Debugging tools
BR2_PACKAGE_STRACE=y
BR2_PACKAGE_LTRACE=y
BR2_PACKAGE_VALGRIND=y
BR2_PACKAGE_GDB=y
BR2_PACKAGE_GDB_SERVER=y

# Package management
BR2_PACKAGE_OPKG=y
BR2_PACKAGE_OPKG_GPG=y

# QEMU support for testing
BR2_PACKAGE_QEMU=y
BR2_PACKAGE_QEMU_SYSTEM=y
BR2_PACKAGE_QEMU_LINUX_USER=y

# Additional ARM64 specific packages
BR2_PACKAGE_LIBATOMIC_OPS=y
BR2_PACKAGE_LIBUNWIND=y

# Hardware monitoring
BR2_PACKAGE_HWDATA=y
BR2_PACKAGE_PCIUTILS=y
BR2_PACKAGE_USBUTILS=y

# Time synchronization
BR2_PACKAGE_CHRONY=y
BR2_PACKAGE_NTP=y

# System logging
BR2_PACKAGE_RSYSLOG=y
BR2_PACKAGE_LOGROTATE=y

# Process management
BR2_PACKAGE_PROCPS=y
BR2_PACKAGE_PROCPS_NG=y

# Memory management
BR2_PACKAGE_NUMACTL=y

# Cryptographic libraries
BR2_PACKAGE_GCRYPT=y
BR2_PACKAGE_GPGME=y

# Network debugging
BR2_PACKAGE_TCPDUMP=y
BR2_PACKAGE_NMAP=y
BR2_PACKAGE_WIRESHARK=y

# File system tools
BR2_PACKAGE_XFSPROGS=y
BR2_PACKAGE_BTRFS_PROGS=y
BR2_PACKAGE_F2FS_TOOLS=y

# System initialization
BR2_PACKAGE_INITSCRIPTS=y
BR2_PACKAGE_START_STOP_DAEMON=y

# Power management
BR2_PACKAGE_POWERTOP=y
BR2_PACKAGE_TLP=y

# System information
BR2_PACKAGE_DMIDECODE=y
BR2_PACKAGE_HWDATA=y
BR2_PACKAGE_INOTIFY_TOOLS=y

# Container support
BR2_PACKAGE_DOCKER_ENGINE=y
BR2_PACKAGE_DOCKER_CLI=y
BR2_PACKAGE_CONTAINERD=y
BR2_PACKAGE_RUNC=y

# Virtualization support
BR2_PACKAGE_KVM=y
BR2_PACKAGE_LIBVIRT=y
BR2_PACKAGE_QEMU=y

# Cross-compilation tools
BR2_PACKAGE_CROSS_COMPILE=y
BR2_PACKAGE_BINUTILS=y
BR2_PACKAGE_BINUTILS_TARGET=y

# Performance monitoring
BR2_PACKAGE_BCC=y
BR2_PACKAGE_BPF_TOOLS=y

# Security tools
BR2_PACKAGE_AIDE=y
BR2_PACKAGE_RKHUNTER=y
BR2_PACKAGE_CHKROOTKIT=y

# Backup tools
BR2_PACKAGE_RSYNC=y
BR2_PACKAGE_BORG=y
BR2_PACKAGE_RESTIC=y

# System recovery
BR2_PACKAGE_GRUB2=y
BR2_PACKAGE_SYSTEMD_BOOT=y
BR2_PACKAGE_EFIVAR=y
```

## buildroot-configs/arm64/raspberrypi4_64_defconfig
```kconfig
# Raspberry Pi 4 (64-bit) Buildroot Configuration
# Optimized for Raspberry Pi 4 Model B with 2GB/4GB/8GB RAM

# Architecture
BR2_aarch64=y
BR2_ARM_FPU_VFPV4=y
BR2_TOOLCHAIN_BUILDROOT_GLIBC=y
BR2_TOOLCHAIN_BUILDROOT_CXX=y
BR2_KERNEL_HEADERS_6_6=y
BR2_PACKAGE_HOST_LINUX_HEADERS_CUSTOM_6_6=y

# System configuration
BR2_ROOTFS_DEVICE_CREATION_DYNAMIC_DEVTMPFS=y
BR2_ROOTFS_DEVICE_TABLE="system/device_table.txt"
BR2_ROOTFS_SKELETON_CUSTOM=y
BR2_ROOTFS_POST_BUILD_SCRIPT="board/post_build.sh"
BR2_ROOTFS_POST_IMAGE_SCRIPT="support/scripts/genimage.sh"

# Kernel
BR2_LINUX_KERNEL=y
BR2_LINUX_KERNEL_CUSTOM_VERSION=y
BR2_LINUX_KERNEL_CUSTOM_VERSION_VALUE="6.6.21"
BR2_LINUX_KERNEL_USE_CUSTOM_CONFIG=y
BR2_LINUX_KERNEL_CUSTOM_CONFIG_FILE="board/raspberrypi4/linux.config"
BR2_LINUX_KERNEL_DTS_SUPPORT=y
BR2_LINUX_KERNEL_INTREE_DTS_NAME="bcm2711-rpi-4-b"
BR2_LINUX_KERNEL_INSTALL_TARGET=y
BR2_LINUX_KERNEL_NEEDS_HOST_OPENSSL=y

# Bootloader
BR2_TARGET_BOOTLOADERS=y
BR2_TARGET_RPI_FIRMWARE=y
BR2_TARGET_RPI_FIRMWARE_CONFIG="board/raspberrypi4/config.txt"
BR2_TARGET_RPI_FIRMWARE_BOOTCODE_BIN=y
BR2_TARGET_RPI_FIRMWARE_VARIANT_PI4=y
BR2_TARGET_UBOOT=y
BR2_TARGET_UBOOT_BUILD_SYSTEM_KCONFIG=y
BR2_TARGET_UBOOT_CUSTOM_VERSION=y
BR2_TARGET_UBOOT_CUSTOM_VERSION_VALUE="2024.04"
BR2_TARGET_UBOOT_CUSTOM_TARBALL=y
BR2_TARGET_UBOOT_CUSTOM_TARBALL_LOCATION=""
BR2_TARGET_UBOOT_BOARD_DEFCONFIG="rpi_4"
BR2_TARGET_UBOOT_NEEDS_DTC=y
BR2_TARGET_UBOOT_NEEDS_PYTHON3=y
BR2_TARGET_UBOOT_NEEDS_SWIG=y
BR2_TARGET_UBOOT_NEEDS_LIBELF=y
BR2_TARGET_UBOOT_FORMAT_IMG=y
BR2_TARGET_UBOOT_SPL=y
BR2_TARGET_UBOOT_SPL_NAME="spl/u-boot-spl.bin"
BR2_TARGET_UBOOT_BOOT_SCRIPT=y
BR2_TARGET_UBOOT_BOOT_SCRIPT_SOURCE="board/raspberrypi4/boot.txt"

# Filesystem
BR2_TARGET_ROOTFS_EXT2=y
BR2_TARGET_ROOTFS_EXT2_4=y
BR2_TARGET_ROOTFS_EXT2_SIZE="1024M"
BR2_TARGET_ROOTFS_EXT2_INODES=0
BR2_TARGET_ROOTFS_EXT2_RES_BLOCKS=0
BR2_TARGET_ROOTFS_TAR=y
BR2_TARGET_ROOTFS_TAR_NONE=y

# Raspberry Pi specific packages
BR2_PACKAGE_RPI_FIRMWARE=y
BR2_PACKAGE_RPI_FIRMWARE_VARIANT_PI4=y
BR2_PACKAGE_LIBFUSE=y
BR2_PACKAGE_LIBFUSE3=y

# GPU/Video Support
BR2_PACKAGE_RPI_USERLAND=y
BR2_PACKAGE_LIBDRM=y
BR2_PACKAGE_LIBGBM=y
BR2_PACKAGE_MESA3D=y
BR2_PACKAGE_MESA3D_GALLIUM_DRIVER_VC4=y
BR2_PACKAGE_MESA3D_OPENGL_EGL=y
BR2_PACKAGE_MESA3D_OPENGL_ES=y

# Audio
BR2_PACKAGE_ALSA_LIB=y
BR2_PACKAGE_ALSA_UTILS=y
BR2_PACKAGE_ALSA_UTILS_ALSACTL=y
BR2_PACKAGE_ALSA_UTILS_APLAY=y
BR2_PACKAGE_ALSA_UTILS_SPEAKER_TEST=y
BR2_PACKAGE_LIBVORBIS=y

# Video Playback
BR2_PACKAGE_FFMPEG=y
BR2_PACKAGE_FFMPEG_GPL=y
BR2_PACKAGE_FFMPEG_POSTPROC=y
BR2_PACKAGE_FFMPEG_SWSCALE=y
BR2_PACKAGE_FFMPEG_AVCODEC=y
BR2_PACKAGE_FFMPEG_AVFORMAT=y
BR2_PACKAGE_GST1_PLUGINS_BASE=y
BR2_PACKAGE_GST1_PLUGINS_BAD=y
BR2_PACKAGE_GST1_PLUGINS_GOOD=y
BR2_PACKAGE_GST1_PLUGINS_UGLY=y
BR2_PACKAGE_GSTREAMER1=y
BR2_PACKAGE_OMXPLAYER=y

# Camera Support
BR2_PACKAGE_LIBCAMERA=y
BR2_PACKAGE_LIBV4L=y
BR2_PACKAGE_V4L_UTILS=y
BR2_PACKAGE_RASPICAM=y
BR2_PACKAGE_FFMPEG_FFMPEG=y
BR2_PACKAGE_OPENCV3=y
BR2_PACKAGE_OPENCV3_CONTRIB=y

# Wireless/Bluetooth
BR2_PACKAGE_WPA_SUPPLICANT=y
BR2_PACKAGE_WPA_SUPPLICANT_CLI=y
BR2_PACKAGE_WPA_SUPPLICANT_PASSPHRASE=y
BR2_PACKAGE_WPA_SUPPLICANT_EAP=y
BR2_PACKAGE_BLUEZ5_UTILS=y
BR2_PACKAGE_BLUEZ5_UTILS_CLIENT=y
BR2_PACKAGE_BLUEZ5_UTILS_DEPRECATED=y
BR2_PACKAGE_DBUS=y
BR2_PACKAGE_DBUS_CPP=y

# Network
BR2_PACKAGE_NETTOOLS=y
BR2_PACKAGE_IFUPDOWN=y
BR2_PACKAGE_IW=y
BR2_PACKAGE_WIRELESS_TOOLS=y
BR2_PACKAGE_DHCPCD=y
BR2_PACKAGE_DROPBEAR=y
BR2_PACKAGE_DROPBEAR_CLIENT=y
BR2_PACKAGE_BRIDGE=y
BR2_PACKAGE_IPERF3=y

# System utilities
BR2_PACKAGE_HTOP=y
BR2_PACKAGE_NANO=y
BR2_PACKAGE_VIM=y
BR2_PACKAGE_TREE=y
BR2_PACKAGE_FILE=y
BR2_PACKAGE_WHICH=y
BR2_PACKAGE_SCREEN=y
BR2_PACKAGE_TMUX=y

# SSH
BR2_PACKAGE_OPENSSH=y
BR2_PACKAGE_OPENSSH_SERVER=y
BR2_PACKAGE_OPENSSH_CLIENT=y

# Development tools
BR2_PACKAGE_GIT=y
BR2_PACKAGE_CURL=y
BR2_PACKAGE_WGET=y
BR2_PACKAGE_UNZIP=y
BR2_PACKAGE_TAR=y
BR2_PACKAGE_RSYNC=y
BR2_PACKAGE_RPI_GPIO=y
BR2_PACKAGE_I2C_TOOLS=y
BR2_PACKAGE_SPI_TOOLS=y

# Python
BR2_PACKAGE_PYTHON3=y
BR2_PACKAGE_PYTHON3_PIP=y
BR2_PACKAGE_PYTHON3_SETUPTOOLS=y
BR2_PACKAGE_PYTHON3_NUMPY=y
BR2_PACKAGE_PYTHON3_PICAMERA2=y
BR2_PACKAGE_PYTHON3_RPI_GPIO=y
BR2_PACKAGE_PYTHON3_SPIDEV=y
BR2_PACKAGE_PYTHON3_SERIAL=y

# Desktop Environment (Optional)
BR2_PACKAGE_XORG7=y
BR2_PACKAGE_XSERVER_XORG_SERVER=y
BR2_PACKAGE_XDRIVER_XF86_INPUT_KEYBOARD=y
BR2_PACKAGE_XDRIVER_XF86_INPUT_MOUSE=y
BR2_PACKAGE_XDRIVER_XF86_INPUT_EVDEV=y
BR2_PACKAGE_XDRIVER_XF86_VIDEO_FBDEV=y
BR2_PACKAGE_XDRIVER_XF86_VIDEO_MODESETTING=y
BR2_PACKAGE_XKEYBOARD_CONFIG=y
BR2_PACKAGE_MATCHBOX=y
BR2_PACKAGE_MATCHBOX_W=y
BR2_PACKAGE_MATCHBOX_LIB=y
BR2_PACKAGE_MATCHBOX_COMMON=y
BR2_PACKAGE_MATCHBOX_DESKTOP=y
BR2_PACKAGE_MATCHBOX_KEYBOARD=y
BR2_PACKAGE_MATCHBOX_PANEL=y
BR2_PACKAGE_PANGO=y
BR2_PACKAGE_LIBGTK2=y
BR2_PACKAGE_GTK2_THEME_ENGINE_HICOLOR=y

# Web Browser
BR2_PACKAGE_NETSURF=y
BR2_PACKAGE_NETSURF_FRONTEND_GTK2=y
BR2_PACKAGE_NETSURF_GTK2=y

# System Management
BR2_PACKAGE_SYSTEMD=y
BR2_PACKAGE_SYSTEMD_JOURNAL_REMOTE=y
BR2_PACKAGE_SYSTEMD_NETWORKD=y
BR2_PACKAGE_SYSTEMD_RESOLVED=y

# Filesystem support
BR2_PACKAGE_DOSFSTOOLS=y
BR2_PACKAGE_E2FSPROGS=y
BR2_PACKAGE_NTFS_3G=y
BR2_PACKAGE_EXFATPROGS=y
BR2_PACKAGE_SQUASHFS=y
BR2_PACKAGE_NFS_UTILS=y
BR2_PACKAGE_CIFS_UTILS=y

# Compression
BR2_PACKAGE_ZIP=y
BR2_PACKAGE_XZ=y
BR2_PACKAGE_GZIP=y
BR2_PACKAGE_BZIP2=y
BR2_PACKAGE_P7ZIP=y

# Libraries
BR2_PACKAGE_OPENSSL=y
BR2_PACKAGE_OPENSSL_BIN=y
BR2_PACKAGE_ZLIB=y
BR2_PACKAGE_LIBPCAP=y
BR2_PACKAGE_LIBUSB=y
BR2_PACKAGE_LIBUSB_COMPAT=y
BR2_PACKAGE_LIBUSB1=y
BR2_PACKAGE_LIBFTDI=y

# GPIO Hardware Support
BR2_PACKAGE_LIBGPIOD=y
BR2_PACKAGE_LIBGPIOD_TOOLS=y
BR2_PACKAGE_GPIOBOARD=y

# Sensors
BR2_PACKAGE_LM_SENSORS=y
BR2_PACKAGE_RTLSDR=y
BR2_PACKAGE_RTL_433=y

# Real-time Support
BR2_PACKAGE_XENOMAI=y
BR2_PACKAGE_XENOMAI_MERCURY=y

# Security
BR2_PACKAGE_SELINUX=y
BR2_PACKAGE_FAIL2BAN=y
BR2_PACKAGE_AUDIT=y

# Compiler tools
BR2_PACKAGE_GCC=y
BR2_PACKAGE_MAKE=y
BR2_PACKAGE_CMAKE=y
BR2_PACKAGE_AUTOCONF=y
BR2_PACKAGE_AUTOMAKE=y
BR2_PACKAGE_LIBTOOL=y
BR2_PACKAGE_NINJA=y

# Documentation
BR2_PACKAGE_MAN=y
BR2_PACKAGE_MAN_PAGES=y
BR2_PACKAGE_INFO=y

# Monitoring
BR2_PACKAGE_VMSTAT=y
BR2_PACKAGE_IOSTAT=y
BR2_PACKAGE_MPSTAT=y
BR2_PACKAGE_PIDSTAT=y
BR2_PACKAGE_NMON=y

# Performance analysis
BR2_PACKAGE_PERF=y
BR2_PACKAGE_BCC=y

# Debugging tools
BR2_PACKAGE_STRACE=y
BR2_PACKAGE_LTRACE=y
BR2_PACKAGE_VALGRIND=y
BR2_PACKAGE_GDB=y
BR2_PACKAGE_GDB_SERVER=y

# Additional packages for multimedia
BR2_PACKAGE_VLC=y
BR2_PACKAGE_OMXPLAYER=y
BR2_PACKAGE_KODI=y
BR2_PACKAGE_KODI_ARCH_ARM64=y
BR2_PACKAGE_KODI_ADVANCEDSETTINGS=y

# Package management
BR2_PACKAGE_OPKG=y
BR2_PACKAGE_OPKG_GPG=y
```

## buildroot-configs/x86_64/generic_x86_64_defconfig
```kconfig
# Generic x86_64 Buildroot Configuration
# Basic Linux system suitable for QEMU and modern x86_64 hardware

# Architecture
BR2_x86_64=y
BR2_x86_corei7=y
BR2_TOOLCHAIN_BUILDROOT_GLIBC=y
BR2_TOOLCHAIN_BUILDROOT_CXX=y

# System configuration
BR2_ROOTFS_DEVICE_CREATION_DYNAMIC_DEVTMPFS=y
BR2_ROOTFS_DEVICE_TABLE="system/device_table.txt"
BR2_ROOTFS_SKELETON_CUSTOM=y
BR2_ROOTFS_POST_BUILD_SCRIPT="board/post_build.sh"
BR2_ROOTFS_POST_IMAGE_SCRIPT="support/scripts/genimage.sh"

# Kernel
BR2_LINUX_KERNEL=y
BR2_LINUX_KERNEL_CUSTOM_VERSION=y
BR2_LINUX_KERNEL_CUSTOM_VERSION_VALUE="6.6.21"
BR2_LINUX_KERNEL_USE_CUSTOM_CONFIG=y
BR2_LINUX_KERNEL_CUSTOM_CONFIG_FILE="board/x86_64/linux.config"
BR2_LINUX_KERNEL_INSTALL_TARGET=y

# Bootloader
BR2_TARGET_GRUB2=y
BR2_TARGET_GRUB2_I386_PC=y
BR2_TARGET_GRUB2_BUILTIN_MODULES="boot linux ext2 fat part_msdos normal"

# Filesystem
BR2_TARGET_ROOTFS_EXT2=y
BR2_TARGET_ROOTFS_EXT2_4=y
BR2_TARGET_ROOTFS_EXT2_SIZE="256M"
BR2_TARGET_ROOTFS_EXT2_INODES=0
BR2_TARGET_ROOTFS_EXT2_RES_BLOCKS=0

# Packages - Essential system
BR2_PACKAGE_BUSYBOX=y
BR2_PACKAGE_BUSYBOX_SHOW_OTHERS=y
BR2_PACKAGE_BUSYBOX_CONFIG="package/busybox/busybox.config"

# Network
BR2_PACKAGE_NETTOOLS=y
BR2_PACKAGE_IFUPDOWN=y
BR2_PACKAGE_WPA_SUPPLICANT=y
BR2_PACKAGE_WPA_SUPPLICANT_CLI=y
BR2_PACKAGE_IW=y

# System utilities
BR2_PACKAGE_HTOP=y
BR2_PACKAGE_NANO=y
BR2_PACKAGE_VIM=y
BR2_PACKAGE_TREE=y
BR2_PACKAGE_FILE=y
BR2_PACKAGE_WHICH=y

# SSH
BR2_PACKAGE_OPENSSH=y
BR2_PACKAGE_OPENSSH_SERVER=y
BR2_PACKAGE_OPENSSH_CLIENT=y

# Development tools
BR2_PACKAGE_GIT=y
BR2_PACKAGE_CURL=y
BR2_PACKAGE_WGET=y
BR2_PACKAGE_UNZIP=y
BR2_PACKAGE_TAR=y

# Audio/Video support
BR2_PACKAGE_ALSA_UTILS=y
BR2_PACKAGE_FFMPEG=y
BR2_PACKAGE_V4L_UTILS=y

# Python for scripting
BR2_PACKAGE_PYTHON3=y
BR2_PACKAGE_PYTHON3_PIP=y
BR2_PACKAGE_PYTHON3_SETUPTOOLS=y

# Graphics (minimal)
BR2_PACKAGE_XORG7=y
BR2_PACKAGE_XSERVER_XORG_SERVER=y
BR2_PACKAGE_XDRIVER_XF86_INPUT_KEYBOARD=y
BR2_PACKAGE_XDRIVER_XF86_INPUT_MOUSE=y
BR2_PACKAGE_XDRIVER_XF86_VIDEO_FBDEV=y
BR2_PACKAGE_FLUXBOX=y

# Management
BR2_PACKAGE_SYSTEMD=y
BR2_PACKAGE_SYSTEMD_JOURNAL_REMOTE=y
BR2_PACKAGE_SYSTEMD_NETWORKD=y

# QEMU support
BR2_PACKAGE_QEMU=y
BR2_PACKAGE_QEMU_SYSTEM=y
BR2_PACKAGE_QEMU_LINUX_USER=y

# Security
BR2_PACKAGE_SELINUX=y
BR2_PACKAGE_FAIL2BAN=y

# Filesystems support
BR2_PACKAGE_DOSFSTOOLS=y
BR2_PACKAGE_E2FSPROGS=y
BR2_PACKAGE_NTFS_3G=y
BR2_PACKAGE_EXFATPROGS=y

# Compression
BR2_PACKAGE_ZIP=y
BR2_PACKAGE_XZ=y
BR2_PACKAGE_GZIP=y
BR2_PACKAGE_BZIP2=y

# Libraries
BR2_PACKAGE_OPENSSL=y
BR2_PACKAGE_ZLIB=y
BR2_PACKAGE_LIBPCAP=y
BR2_PACKAGE_LIBUSB=y
BR2_PACKAGE_LIBUSB_COMPAT=y

# Compiler tools
BR2_PACKAGE_GCC=y
BR2_PACKAGE_MAKE=y
BR2_PACKAGE_CMAKE=y
BR2_PACKAGE_AUTOCONF=y
BR2_PACKAGE_AUTOMAKE=y
BR2_PACKAGE_LIBTOOL=y

# Documentation
BR2_PACKAGE_MAN=y
BR2_PACKAGE_MAN_PAGES=y
BR2_PACKAGE_INFO=y
```
